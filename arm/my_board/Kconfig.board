## arm/my_board/Kconfig.board
```kconfig
# Copyright (c) 2023 Nordic Semiconductor ASA
# SPDX-License-Identifier: Apache-2.0

config BOARD_MY_BOARD
	bool "My_Board"
	depends on SOC_NRF52840_QIAA
```

## arm/my_board/Kconfig.defconfig
```kconfig
# Copyright (c) 2023 Nordic Semiconductor ASA
# SPDX-License-Identifier: Apache-2.0

if BOARD_MY_BOARD

config BOARD
	default "my_board"

config BT_CTLR
   default BT

endif
```

## boards/shields/qorvo_dwm3000/Kconfig.defconfig.bak
```kconfig
# Copyright (c) 2021 Callender-Consulting, LLC
# SPDX-License-Identifier: Apache-2.0

if SHIELD_QORVO_DWM3000
config GPIO
	default y
config SPI
	default y

endif # SHIELD_SHIELD_QORVO_DWM3000
```
